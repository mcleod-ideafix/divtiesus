EOK             equ     1 
ENONSENSE       equ     2 
ESTEND          equ     3 
EWRTYPE         equ     4 
ENOENT          equ 5       ; No such file or directory.  
EIO     equ 6       ; I/O error 
EINVAL      equ 7       ; Invalid file name 
EACCES      equ 8       ; Access Denied 
ENOSPC      equ 9       ; No space left on device 
ENXIO           equ     10               ; Request beyond the limits of the device 
ENODRV          equ     11              ; No such drive 
ENFILE          equ     12              ; Too many files open in system 
EBADF           equ     13              ; Bad file descriptor 
ENODEV          equ     14         ; No such device
EOVERFLOW       equ     15 
EISDIR          equ     16 
ENOTDIR         equ     17 
EEXIST          equ     18 
EPATH           equ 19      ; Invalid path 
ENOSYS          equ     20 
ENAMETOOLONG    equ     21 
ENOCMD          equ     22 
EINUSE          equ     23 
ERDONLY         equ     24 
